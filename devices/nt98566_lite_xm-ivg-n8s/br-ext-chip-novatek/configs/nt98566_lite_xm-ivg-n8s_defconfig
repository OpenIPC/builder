## devices/nt98566_lite_xm-ivg-n8s/br-ext-chip-novatek/configs/nt98566_lite_xm-ivg-n8s_defconfig
```kconfig
# Architecture
BR2_arm=y
BR2_cortex_a9=y
BR2_ARM_ENABLE_NEON=y
BR2_ARM_ENABLE_VFP=y
BR2_ARM_FPU_VFPV3=y
BR2_ARM_INSTRUCTIONS_THUMB2=y

# Toolchain
BR2_TOOLCHAIN_EXTERNAL=y
BR2_TOOLCHAIN_EXTERNAL_CUSTOM=y
BR2_TOOLCHAIN_EXTERNAL_DOWNLOAD=y
BR2_TOOLCHAIN_EXTERNAL_URL="https://github.com/openipc/firmware/releases/download/$(OPENIPC_TOOLCHAIN).tgz"
BR2_TOOLCHAIN_EXTERNAL_CUSTOM_PREFIX="arm-openipc-linux-musleabihf"
BR2_TOOLCHAIN_EXTERNAL_HEADERS_4_19=y
BR2_TOOLCHAIN_EXTERNAL_CUSTOM_MUSL=y
BR2_TOOLCHAIN_EXTERNAL_CXX=y

# Kernel
BR2_LINUX_KERNEL=y
BR2_LINUX_KERNEL_CUSTOM_TARBALL=y
BR2_LINUX_KERNEL_CUSTOM_TARBALL_LOCATION="https://github.com/openipc/linux/archive/$(OPENIPC_KERNEL).tar.gz"
BR2_LINUX_KERNEL_USE_CUSTOM_CONFIG=y
BR2_LINUX_KERNEL_CUSTOM_CONFIG_FILE="$(EXTERNAL_VENDOR)/board/$(OPENIPC_SOC_FAMILY)/nt98566.generic.config"
BR2_LINUX_KERNEL_UIMAGE=y
BR2_LINUX_KERNEL_XZ=y

# Filesystem
BR2_PACKAGE_BUSYBOX_CONFIG="$(BR2_EXTERNAL)/package/busybox/busybox.config"
BR2_PACKAGE_UBOOT_TOOLS=y
BR2_PACKAGE_ZLIB=y
# BR2_PACKAGE_IFUPDOWN_SCRIPTS is not set
BR2_PACKAGE_WIREGUARD_LINUX_COMPAT=y
BR2_PACKAGE_WIREGUARD_TOOLS=y
BR2_TARGET_ROOTFS_CPIO=y
BR2_TARGET_ROOTFS_SQUASHFS=y
BR2_TARGET_ROOTFS_SQUASHFS4_XZ=y

# OpenIPC
BR2_OPENIPC_SOC_VENDOR="novatek"
BR2_OPENIPC_SOC_MODEL="nt98566"
BR2_OPENIPC_SOC_FAMILY="nt9856x"
BR2_OPENIPC_VARIANT="lite"
# The chip is 16 MB (GD25Q128), but this is the 8 MB NOR layout on purpose:
# it is firmware's nt98566_lite layout, the one the owner's camera runs
# today, and the rest of the chip is rootfs_data. The 16 MB layout is a
# different partition table and has not been tried on this board.
BR2_OPENIPC_FLASH_SIZE="8"

# Packages
BR2_PACKAGE_DROPBEAR_OPENIPC=y
BR2_PACKAGE_IPCTOOL=y
BR2_PACKAGE_LIBCURL_OPENIPC=y
BR2_PACKAGE_LIBCURL_OPENIPC_CURL=y
# BR2_PACKAGE_LIBCURL_OPENIPC_PROXY_SUPPORT is not set
# BR2_PACKAGE_LIBCURL_OPENIPC_COOKIES_SUPPORT is not set
# BR2_PACKAGE_LIBCURL_OPENIPC_EXTRA_PROTOCOLS_FEATURES is not set
BR2_PACKAGE_LIBEVENT_OPENIPC=y
BR2_PACKAGE_LIBOGG_OPENIPC=y
BR2_PACKAGE_MAJESTIC_FONTS=y
BR2_PACKAGE_MAJESTIC_WEBUI=y
BR2_PACKAGE_MAJESTIC=y
BR2_PACKAGE_MBEDTLS_OPENIPC=y
BR2_PACKAGE_MOTORS=y
BR2_PACKAGE_NOVATEK_OSDRV_NT9856X=y
BR2_PACKAGE_NOVATEK_OPENSDK=y
BR2_PACKAGE_OPUS_OPENIPC=y
BR2_PACKAGE_OPUS_OPENIPC_FIXED_POINT=y
BR2_PACKAGE_VTUND_OPENIPC=y
BR2_PACKAGE_YAML_CLI=y
```

## package/aic8800-openipc/Config.in
```kconfig
config BR2_PACKAGE_AIC8800_OPENIPC
	bool "aic8800-openipc"
	depends on BR2_LINUX_KERNEL
	help
	  AIC8800 wireless driver

config BR2_PACKAGE_AIC8800_OPENIPC_FIRMWARE_D80
	bool "AIC8800D80 firmware"
	depends on BR2_PACKAGE_AIC8800_OPENIPC
	help
	  Install firmware and configuration files for AIC8800D80 USB adapters.
```

## package/gc6153/Config.in
```kconfig
config BR2_PACKAGE_GC6153
	bool "gc6153"
	depends on BR2_mipsel
	help
	  Userspace tool for the GC6153F 5-channel stepper/ircut driver
	  on the Vstarcam C8622 (Ingenic T23). The GC6153 is a dual
	  SPI/I2C chip; this board wires it in i2c mode at 7-bit 0x10.
	  Datasheet summary:
	  https://damodev.csdn.net/6823f4b5a5baf817cf4b3f9c.html

	  The chip sits on a bit-banged i2c bus (PB21/PB20) that no kernel
	  adapter owns, so the tool drives it through /dev/mem. Commands:
	  init (the vendor init table, required after every power cycle),
	  ircut day/night pulse, pan/tilt bursts, raw register access, and
	  one-shot GPIO drive (the IR and white lamps hang off GPIO61/GPIO50
	  with the shared brightness line on PB17).

	  Installs /usr/sbin/gc6153 and /etc/init.d/S65gc6153, which runs
	  the chip init at boot and parks the lamp lines.
```
